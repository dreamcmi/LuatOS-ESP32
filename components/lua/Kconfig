## sdkconfig.defaults
```kconfig
CONFIG_ESP_SYSTEM_EVENT_TASK_STACK_SIZE=4096
CONFIG_ESP_MAIN_TASK_STACK_SIZE=4096
CONFIG_ESP_IPC_TASK_STACK_SIZE=4096
CONFIG_ESP_MINIMAL_SHARED_STACK_SIZE=4096

CONFIG_BOOTLOADER_LOG_LEVEL_ERROR=y
CONFIG_LOG_DEFAULT_LEVEL_ERROR=y
# CONFIG_LOG_COLORS is not set

CONFIG_LWIP_LOCAL_HOSTNAME="luatos_esp32"
# CONFIG_LWIP_TIMERS_ONDEMAND is not set

CONFIG_BOOTLOADER_COMPILER_OPTIMIZATION_SIZE=y
CONFIG_COMPILER_OPTIMIZATION_SIZE=y

CONFIG_APP_PROJECT_VER_FROM_CONFIG=y
CONFIG_APP_PROJECT_VER="V0004-BETA"

CONFIG_NEWLIB_NANO_FORMAT=y

CONFIG_ESP_TLS_INSECURE=y
CONFIG_ESP_TLS_SKIP_SERVER_CERT_VERIFY=y

CONFIG_PM_ENABLE=y
CONFIG_FREERTOS_USE_TICKLESS_IDLE=y

# CONFIG_ESP_TASK_WDT_CHECK_IDLE_TASK_CPU0 is not set

CONFIG_FREERTOS_HZ=1000
```

## sdkconfig.defaults.esp32
```kconfig
CONFIG_ESPTOOLPY_FLASHMODE_QIO=y
CONFIG_ESP32_WIFI_STATIC_TX_BUFFER=y
CONFIG_ESP32_WIFI_TX_BUFFER_TYPE=0
CONFIG_ESP32_WIFI_STATIC_TX_BUFFER_NUM=16
CONFIG_ESP32_WIFI_CACHE_TX_BUFFER_NUM=32

CONFIG_ESPTOOLPY_FLASHSIZE_4MB=y
CONFIG_ESPTOOLPY_FLASHSIZE="4MB"
CONFIG_PARTITION_TABLE_CUSTOM=y
CONFIG_PARTITION_TABLE_CUSTOM_FILENAME="huge_app.csv"
CONFIG_PARTITION_TABLE_FILENAME="huge_app.csv"
```

## sdkconfig.defaults.esp32c3
```kconfig
CONFIG_ESPTOOLPY_FLASHMODE_DIO=y
CONFIG_ESPTOOLPY_FLASHSIZE_4MB=y
CONFIG_ESPTOOLPY_FLASHSIZE="4MB"
CONFIG_PARTITION_TABLE_CUSTOM=y
CONFIG_PARTITION_TABLE_CUSTOM_FILENAME="partitions.csv"
CONFIG_PARTITION_TABLE_FILENAME="partitions.csv"

CONFIG_ESP32C3_DEFAULT_CPU_FREQ_160=y
CONFIG_ESP32C3_DEFAULT_CPU_FREQ_MHZ=160

CONFIG_ESP_TASK_WDT_TIMEOUT_S=10

CONFIG_BT_ENABLED=y
CONFIG_BT_BLUEDROID_ENABLED=y
```

## sdkconfig.defaults.esp32s3
```kconfig
CONFIG_ESPTOOLPY_FLASHMODE_QIO=y
CONFIG_ESPTOOLPY_FLASHSIZE_8MB=y
CONFIG_ESPTOOLPY_FLASHSIZE="8MB"
CONFIG_PARTITION_TABLE_CUSTOM=y
CONFIG_PARTITION_TABLE_CUSTOM_FILENAME="partitions_8m.csv"
CONFIG_PARTITION_TABLE_FILENAME="partitions_8m.csv"

CONFIG_ESP32S3_DEFAULT_CPU_FREQ_240=y
CONFIG_ESP32S3_DEFAULT_CPU_FREQ_MHZ=240

CONFIG_ESP_TASK_WDT_TIMEOUT_S=10

CONFIG_BT_ENABLED=y
CONFIG_BT_BLUEDROID_ENABLED=y

#CONFIG_ESP32S3_SPIRAM_SUPPORT=y
#CONFIG_SPIRAM_MODE_OCT=y
#CONFIG_SPIRAM_TYPE_AUTO=y
#CONFIG_SPIRAM_SIZE=-1
#CONFIG_SPIRAM_SPEED_80M=y
#CONFIG_SPIRAM=y
#CONFIG_SPIRAM_IGNORE_NOTFOUND=y
```
